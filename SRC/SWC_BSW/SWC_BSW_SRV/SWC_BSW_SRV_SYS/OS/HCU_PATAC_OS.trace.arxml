AUTOSAR XML (schema 4-0-3)
package /APP1
  ecuc value collection Configuration: ecuc-values=RTAOS
  module config RTAOS: definition=Os
    15 x OsTask, all with OsTraceFilter=ALWAYS:
      TASK_INIT
      TASK_POWER_UP
      TASK_POWER_DOWN
      TASK_WATCHDOG
      OSTSK_S_WTDG_REFRESH_WATCHDOG
      TASK_TIME_1MS
      TASK_TIME_2MS
      TASK_TIME_5MS
      TASK_TIME_10MS
      TASK_TIME_20MS
      TASK_TIME_50MS
      TASK_TIME_100MS
      TASK_TIME_200MS
      TASK_TIME_1000MS
      OSTSK_S_RTMCLD_CPU_LOAD_MNG
    19 x OsIsr, all with OsTraceFilter=ALWAYS:
      SRC_GTM_GTM0_TIM0_3_ISR
      MAIN_OSISR_P_PIM1ms
      SRC_CAN_CAN0_INT1_ISR
      SRC_CAN_CAN0_INT6_ISR
      SRC_CAN_CAN0_INT0_ISR
      SRC_CAN_CAN0_INT8_ISR
      SRC_CAN_CAN0_INT2_ISR
      SRC_CAN_CAN0_INT7_ISR
      SRC_CAN_CAN0_INT4_ISR
      SRC_CAN_CAN0_INT5_ISR
      SRC_CAN_CAN0_INT3_ISR
      SRC_GTM_GTM0_TOM0_7_ISR
      SRC_QSPI_QSPI3_ERR_ISR
      SRC_QSPI_QSPI3_PT_ISR
      SRC_QSPI_QSPI3_U_ISR
      DMA_ISR_QSPI3RX
      DMA_ISR_QSPI3TX
      TSKSRV_ACTIVATION_MANAGER_IT
      ISR_GRP_0_END_OF_CONV
    Trace (OsTrace):
      OsTraceType = NONE
      OsTraceCompactID = false
      OsTraceCompactTime = false
      OsTraceTgtStack = false
      OsTraceTgtTrigger = false
      OsTraceAutoComms = false
      OsTraceAutoRepeat = false
      OsTraceBufferSize = 200
      OsTraceAuto = NONE
      15 x OsClass, all with OsClassFilter=ALWAYS, OsClassAutostart=false:
        TASKS_AND_ISRS
        STARTUP_AND_SHUTDOWN
        ACTIVATIONS
        ALARMS
        SCHEDULETABLES
        EXPIRY_POINTS
        RESOURCES
        INTERRUPT_LOCKS
        ERRORS
        MESSAGE_DATA
        SWITCHING_OVERHEADS
        OSEK_EVENTS
        TRACEPOINT
        TASK_TRACEPOINT
        INTERVALS
