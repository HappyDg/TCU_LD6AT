AUTOSAR XML (schema 4-0-3)
package /APP1
  ecuc value collection Configuration: ecuc-values=RTAOS
  module config RTAOS: definition=Os
    VEMS (OsOS)
      Hooks (OsHooks): OsStackFaultHook=false
      6 x Param:
        MeterExecution: Value=true
        AllowFastActivation: Value=false
        AllowSharedPriority: Value=true
        CountedDispatch: Value=true
        MinPreempPrio: Value=0
        DefaultHeavyweight: Value=true
