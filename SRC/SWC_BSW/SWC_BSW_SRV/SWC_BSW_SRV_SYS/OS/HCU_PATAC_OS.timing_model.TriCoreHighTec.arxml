AUTOSAR XML (schema 4-0-3)
package /APP1
  ecuc value collection Configuration: ecuc-values=RTAOS
  module config RTAOS: definition=Os
