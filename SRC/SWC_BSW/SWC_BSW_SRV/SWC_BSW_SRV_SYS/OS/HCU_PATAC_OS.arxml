AUTOSAR XML (schema 4-0-3)
package /APP1
  ecuc value collection Configuration: ecuc-values=RTAOS
  module config RTAOS: definition=Os
    VEMS (OsOS):
      OsStatus = STANDARD
      OsScalabilityClass = SC1
      OsStackMonitoring = false
      OsUseGetServiceId = true
      OsUseParameterAccess = true
      OsUseResScheduler = true
      OsDefaultInterrupt = SWFAIL_vidDefaultIsr
      OsDefTaskStack = 8192,8192
      OsDefCat1Stack = 8192,8192
      OsDefCat2Stack = 8192,8192
      OsNumberOfCores = 1
      Hooks (OsHooks): OsStartupHook=true, OsShutdownHook=true, OsPreTaskHook=true, OsPostTaskHook=true, OsProtectionHook=false, OsErrorHook=true
    OSDEFAULTAPPMODE (OsAppMode)
    15 x OsTask, all with OsTaskActivation=1:
      TASK_INIT: OsTaskPriority=65535, OsTaskSchedule=NON
        Autostart (OsTaskAutostart): OsTaskAppModeRef=OSDEFAULTAPPMODE
      TASK_POWER_UP: OsTaskPriority=153, OsTaskSchedule=NON
        Autostart (OsTaskAutostart): OsTaskAppModeRef=OSDEFAULTAPPMODE
      TASK_POWER_DOWN: OsTaskPriority=33, OsTaskSchedule=NON
        OsTaskAutostart: OsTaskAppModeRef=OSDEFAULTAPPMODE
      TASK_WATCHDOG: OsTaskPriority=2, OsTaskSchedule=FULL
        OsTaskAutostart: OsTaskAppModeRef=OSDEFAULTAPPMODE
      OSTSK_S_WTDG_REFRESH_WATCHDOG: OsTaskPriority=1, OsTaskSchedule=FULL
        OsTaskAutostart: OsTaskAppModeRef=OSDEFAULTAPPMODE
      TASK_TIME_1MS: OsTaskPriority=1232, OsTaskSchedule=FULL
        OsTaskAutostart: OsTaskAppModeRef=OSDEFAULTAPPMODE
      TASK_TIME_2MS: OsTaskPriority=1216, OsTaskSchedule=FULL
        OsTaskAutostart: OsTaskAppModeRef=OSDEFAULTAPPMODE
      TASK_TIME_5MS: OsTaskPriority=1184, OsTaskSchedule=FULL
        OsTaskAutostart: OsTaskAppModeRef=OSDEFAULTAPPMODE
      TASK_TIME_10MS: OsTaskPriority=1088, OsTaskSchedule=FULL
        OsTaskAutostart: OsTaskAppModeRef=OSDEFAULTAPPMODE
      TASK_TIME_20MS: OsTaskPriority=960, OsTaskSchedule=FULL
        OsTaskAutostart: OsTaskAppModeRef=OSDEFAULTAPPMODE
      TASK_TIME_50MS: OsTaskPriority=800, OsTaskSchedule=FULL
        OsTaskAutostart: OsTaskAppModeRef=OSDEFAULTAPPMODE
      TASK_TIME_100MS: OsTaskPriority=784, OsTaskSchedule=FULL
        OsTaskAutostart: OsTaskAppModeRef=OSDEFAULTAPPMODE
      TASK_TIME_200MS: OsTaskPriority=736, OsTaskSchedule=FULL
        OsTaskAutostart: OsTaskAppModeRef=OSDEFAULTAPPMODE
      TASK_TIME_1000MS: OsTaskPriority=656, OsTaskSchedule=FULL
        OsTaskAutostart: OsTaskAppModeRef=OSDEFAULTAPPMODE
      OSTSK_S_RTMCLD_CPU_LOAD_MNG: OsTaskPriority=0, OsTaskSchedule=FULL
        Autostart (OsTaskAutostart): OsTaskAppModeRef=OSDEFAULTAPPMODE
    19 x OsIsr:
      SRC_GTM_GTM0_TIM0_3_ISR: OsIsrCategory=CATEGORY_1, OsIsrPriority=140, OsIsrAddress=SRC_GTMTIM03
      MAIN_OSISR_P_PIM1ms: OsIsrCategory=CATEGORY_2, OsIsrPriority=99, OsIsrAddress=SRC_STM0SR0
      SRC_CAN_CAN0_INT1_ISR: OsIsrCategory=CATEGORY_2, OsIsrPriority=20, OsIsrAddress=SRC_CANINT1
      SRC_CAN_CAN0_INT6_ISR: OsIsrCategory=CATEGORY_2, OsIsrPriority=15, OsIsrAddress=SRC_CANINT6
      SRC_CAN_CAN0_INT0_ISR: OsIsrCategory=CATEGORY_2, OsIsrPriority=17, OsIsrAddress=SRC_CANINT0
      SRC_CAN_CAN0_INT8_ISR: OsIsrCategory=CATEGORY_2, OsIsrPriority=21, OsIsrAddress=SRC_CANINT8
      SRC_CAN_CAN0_INT2_ISR: OsIsrCategory=CATEGORY_2, OsIsrPriority=23, OsIsrAddress=SRC_CANINT2
      SRC_CAN_CAN0_INT7_ISR: OsIsrCategory=CATEGORY_2, OsIsrPriority=18, OsIsrAddress=SRC_CAN1INT7
      SRC_CAN_CAN0_INT4_ISR: OsIsrCategory=CATEGORY_2, OsIsrPriority=19, OsIsrAddress=SRC_CANINT4
      SRC_CAN_CAN0_INT5_ISR: OsIsrCategory=CATEGORY_2, OsIsrPriority=22, OsIsrAddress=SRC_CANINT5
      SRC_CAN_CAN0_INT3_ISR: OsIsrCategory=CATEGORY_2, OsIsrPriority=16, OsIsrAddress=SRC_CANINT3
      SRC_GTM_GTM0_TOM0_7_ISR: OsIsrCategory=CATEGORY_1, OsIsrPriority=131, OsIsrAddress=SRC_GTMTOM07
      SRC_QSPI_QSPI3_ERR_ISR: OsIsrCategory=CATEGORY_2, OsIsrPriority=101, OsIsrAddress=SRC_QSPI3ERR
      SRC_QSPI_QSPI3_PT_ISR: OsIsrCategory=CATEGORY_2, OsIsrPriority=102, OsIsrAddress=SRC_QSPI3PT
      SRC_QSPI_QSPI3_U_ISR: OsIsrCategory=CATEGORY_2, OsIsrPriority=103, OsIsrAddress=SRC_QSPI3U
      DMA_ISR_QSPI3RX: OsIsrCategory=CATEGORY_2, OsIsrPriority=31, OsIsrAddress=SRC_DMACH6
      DMA_ISR_QSPI3TX: OsIsrCategory=CATEGORY_2, OsIsrPriority=32, OsIsrAddress=SRC_DMACH7
      TSKSRV_ACTIVATION_MANAGER_IT: OsIsrCategory=CATEGORY_2, OsIsrPriority=127, OsIsrAddress=SRC_GPSR00
      ISR_GRP_0_END_OF_CONV: OsIsrCategory=CATEGORY_1, OsIsrPriority=130, OsIsrAddress=SRC_VADCG0SR0
    MAIN_OSCNT_PIM1ms (OsCounter): OsCounterTicksPerBase=1, OsCounterMaxAllowedValue=65535, OsCounterType=SOFTWARE, OsCounterMinCycle=1, OsSecondsPerTick=0.001
    TriCoreHighTec (OsRTATarget): OsRTATargetVersion=5.0.9, OsRTATargetVariant=TC23x
      mcpu (Param): Value=tc26xx
    MAIN_OSAPP (OsApplication):
      OsTrusted = true
      OsApplicationCoreAssignment = 0
      OsAppIsrRef = ISR_GRP_0_END_OF_CONV
      OsAppIsrRef = SRC_GTM_GTM0_TOM0_7_ISR
      OsAppIsrRef = SRC_CAN_CAN0_INT0_ISR
      OsAppIsrRef = SRC_CAN_CAN0_INT1_ISR
      OsAppIsrRef = SRC_CAN_CAN0_INT{6..8}_ISR
      OsAppIsrRef = SRC_CAN_CAN0_INT{2..5}_ISR
      OsAppIsrRef = MAIN_OSISR_P_PIM1ms
      OsAppIsrRef = SRC_GTM_GTM0_TIM0_3_ISR
      OsAppIsrRef = SRC_QSPI_QSPI3_ERR_ISR
      OsAppIsrRef = SRC_QSPI_QSPI3_PT_ISR
      OsAppIsrRef = SRC_QSPI_QSPI3_U_ISR
      OsAppIsrRef = TSKSRV_ACTIVATION_MANAGER_IT
      OsAppCounterRef = MAIN_OSCNT_PIM50ms
      OsAppCounterRef = MAIN_OSCNT_PIM1ms
      OsAppIsrRef = DMA_ISR_QSPI3RX
      OsAppIsrRef = DMA_ISR_QSPI3TX
      OsAppTaskRef = TASK_INIT
      OsAppTaskRef = OSTSK_S_WTDG_REFRESH_WATCHDOG
      OsAppTaskRef = OSTSK_S_RTMCLD_CPU_LOAD_MNG
      OsAppTaskRef = TASK_POWER_DOWN
      OsAppTaskRef = TASK_POWER_UP
      OsAppTaskRef = TASK_TIME_1000MS
      OsAppTaskRef = TASK_TIME_100MS
      OsAppTaskRef = TASK_TIME_10MS
      OsAppTaskRef = TASK_TIME_1MS
      OsAppTaskRef = TASK_TIME_200MS
      OsAppTaskRef = TASK_TIME_20MS
      OsAppTaskRef = TASK_TIME_2MS
      OsAppTaskRef = TASK_TIME_50MS
      OsAppTaskRef = TASK_TIME_5MS
      OsAppTaskRef = TASK_WATCHDOG
      OsRestartTask = TASK_POWER_UP
      OsAppScheduleTableRef = MAIN_OSSCT_PIM1ms
      OsAppScheduleTableRef = MAIN_OSSCT_PIM50ms
      OsAppIsrRef = DMA_ISR_QSPI2RX
      OsAppIsrRef = DMA_ISR_QSPI2TX
      OsAppIsrRef = SRC_QSPI_QSPI2_ERR_ISR
      OsAppIsrRef = SRC_QSPI_QSPI2_PT_ISR
      OsAppIsrRef = SRC_QSPI_QSPI2_U_ISR
      OsApplicationHooks: OsAppStartupHook=true, OsAppShutdownHook=true, OsAppErrorHook=true
    MAIN_OSCNT_PIM50ms (OsCounter):
      OsCounterMinCycle = 1
      OsCounterMaxAllowedValue = 65535
      OsCounterTicksPerBase = 2
      OsSecondsPerTick = 0.05
      OsCounterType = SOFTWARE
      OsCounterAccessingApplication = MAIN_OSAPP
    MAIN_OSSCT_PIM1ms (OsScheduleTable): OsScheduleTableRepeating=true, OsScheduleTableDuration=100, OsScheduleTableCounterRef=MAIN_OSCNT_PIM1ms
      100 x OsScheduleTableExpiryPoint:
        EP_0: OsScheduleTblExpPointOffset=0
          Ac0 (OsScheduleTableTaskActivation): OsScheduleTableActivateTaskRef=TASK_TIME_1MS
        EP_1: OsScheduleTblExpPointOffset=1
          Ac0 (OsScheduleTableTaskActivation): OsScheduleTableActivateTaskRef=TASK_TIME_1MS
          Ac1 (OsScheduleTableTaskActivation): OsScheduleTableActivateTaskRef=TASK_TIME_2MS
        EP_2: OsScheduleTblExpPointOffset=2
          Ac0 (OsScheduleTableTaskActivation): OsScheduleTableActivateTaskRef=TASK_TIME_1MS
        EP_3: OsScheduleTblExpPointOffset=3
          Ac0 (OsScheduleTableTaskActivation): OsScheduleTableActivateTaskRef=TASK_TIME_1MS
          Ac1 (OsScheduleTableTaskActivation): OsScheduleTableActivateTaskRef=TASK_TIME_2MS
        EP_4: OsScheduleTblExpPointOffset=4
          Ac0 (OsScheduleTableTaskActivation): OsScheduleTableActivateTaskRef=TASK_TIME_1MS
          Ac1 (OsScheduleTableTaskActivation): OsScheduleTableActivateTaskRef=TASK_TIME_5MS
        EP_5: OsScheduleTblExpPointOffset=5
          Ac0 (OsScheduleTableTaskActivation): OsScheduleTableActivateTaskRef=TASK_TIME_1MS
          Ac1 (OsScheduleTableTaskActivation): OsScheduleTableActivateTaskRef=TASK_TIME_2MS
        EP_6: OsScheduleTblExpPointOffset=6
          Ac0 (OsScheduleTableTaskActivation): OsScheduleTableActivateTaskRef=TASK_TIME_1MS
        EP_7: OsScheduleTblExpPointOffset=7
          Ac0 (OsScheduleTableTaskActivation): OsScheduleTableActivateTaskRef=TASK_TIME_1MS
          Ac1 (OsScheduleTableTaskActivation): OsScheduleTableActivateTaskRef=TASK_TIME_2MS
        EP_8: OsScheduleTblExpPointOffset=8
          Ac0 (OsScheduleTableTaskActivation): OsScheduleTableActivateTaskRef=TASK_TIME_1MS
        EP_9: OsScheduleTblExpPointOffset=9
          4 x OsScheduleTableTaskActivation:
            Ac0: OsScheduleTableActivateTaskRef=TASK_TIME_1MS
            Ac1: OsScheduleTableActivateTaskRef=TASK_TIME_2MS
            Ac2: OsScheduleTableActivateTaskRef=TASK_TIME_5MS
            Ac3: OsScheduleTableActivateTaskRef=TASK_TIME_10MS
        EP_10: OsScheduleTblExpPointOffset=10
          Ac0 (OsScheduleTableTaskActivation): OsScheduleTableActivateTaskRef=TASK_TIME_1MS
        EP_11: OsScheduleTblExpPointOffset=11
          Ac0 (OsScheduleTableTaskActivation): OsScheduleTableActivateTaskRef=TASK_TIME_1MS
          Ac1 (OsScheduleTableTaskActivation): OsScheduleTableActivateTaskRef=TASK_TIME_2MS
        EP_12: OsScheduleTblExpPointOffset=12
          Ac0 (OsScheduleTableTaskActivation): OsScheduleTableActivateTaskRef=TASK_TIME_1MS
        EP_13: OsScheduleTblExpPointOffset=13
          Ac0 (OsScheduleTableTaskActivation): OsScheduleTableActivateTaskRef=TASK_TIME_1MS
          Ac1 (OsScheduleTableTaskActivation): OsScheduleTableActivateTaskRef=TASK_TIME_2MS
        EP_14: OsScheduleTblExpPointOffset=14
          Ac0 (OsScheduleTableTaskActivation): OsScheduleTableActivateTaskRef=TASK_TIME_1MS
          Ac1 (OsScheduleTableTaskActivation): OsScheduleTableActivateTaskRef=TASK_TIME_5MS
        EP_15: OsScheduleTblExpPointOffset=15
          Ac0 (OsScheduleTableTaskActivation): OsScheduleTableActivateTaskRef=TASK_TIME_1MS
          Ac1 (OsScheduleTableTaskActivation): OsScheduleTableActivateTaskRef=TASK_TIME_2MS
        EP_16: OsScheduleTblExpPointOffset=16
          Ac0 (OsScheduleTableTaskActivation): OsScheduleTableActivateTaskRef=TASK_TIME_1MS
        EP_17: OsScheduleTblExpPointOffset=17
          Ac0 (OsScheduleTableTaskActivation): OsScheduleTableActivateTaskRef=TASK_TIME_1MS
          Ac1 (OsScheduleTableTaskActivation): OsScheduleTableActivateTaskRef=TASK_TIME_2MS
        EP_18: OsScheduleTblExpPointOffset=18
          Ac0 (OsScheduleTableTaskActivation): OsScheduleTableActivateTaskRef=TASK_TIME_1MS
        EP_19: OsScheduleTblExpPointOffset=19
          5 x OsScheduleTableTaskActivation:
            Ac0: OsScheduleTableActivateTaskRef=TASK_TIME_1MS
            Ac1: OsScheduleTableActivateTaskRef=TASK_TIME_2MS
            Ac2: OsScheduleTableActivateTaskRef=TASK_TIME_5MS
            Ac3: OsScheduleTableActivateTaskRef=TASK_TIME_10MS
            Ac4: OsScheduleTableActivateTaskRef=TASK_TIME_20MS
        EP_20: OsScheduleTblExpPointOffset=20
          Ac0 (OsScheduleTableTaskActivation): OsScheduleTableActivateTaskRef=TASK_TIME_1MS
        EP_21: OsScheduleTblExpPointOffset=21
          Ac0 (OsScheduleTableTaskActivation): OsScheduleTableActivateTaskRef=TASK_TIME_1MS
          Ac1 (OsScheduleTableTaskActivation): OsScheduleTableActivateTaskRef=TASK_TIME_2MS
        EP_22: OsScheduleTblExpPointOffset=22
          Ac0 (OsScheduleTableTaskActivation): OsScheduleTableActivateTaskRef=TASK_TIME_1MS
        EP_23: OsScheduleTblExpPointOffset=23
          Ac0 (OsScheduleTableTaskActivation): OsScheduleTableActivateTaskRef=TASK_TIME_1MS
          Ac1 (OsScheduleTableTaskActivation): OsScheduleTableActivateTaskRef=TASK_TIME_2MS
        EP_24: OsScheduleTblExpPointOffset=24
          Ac0 (OsScheduleTableTaskActivation): OsScheduleTableActivateTaskRef=TASK_TIME_1MS
          Ac1 (OsScheduleTableTaskActivation): OsScheduleTableActivateTaskRef=TASK_TIME_5MS
        EP_25: OsScheduleTblExpPointOffset=25
          Ac0 (OsScheduleTableTaskActivation): OsScheduleTableActivateTaskRef=TASK_TIME_1MS
          Ac1 (OsScheduleTableTaskActivation): OsScheduleTableActivateTaskRef=TASK_TIME_2MS
        EP_26: OsScheduleTblExpPointOffset=26
          Ac0 (OsScheduleTableTaskActivation): OsScheduleTableActivateTaskRef=TASK_TIME_1MS
        EP_27: OsScheduleTblExpPointOffset=27
          Ac0 (OsScheduleTableTaskActivation): OsScheduleTableActivateTaskRef=TASK_TIME_1MS
          Ac1 (OsScheduleTableTaskActivation): OsScheduleTableActivateTaskRef=TASK_TIME_2MS
        EP_28: OsScheduleTblExpPointOffset=28
          Ac0 (OsScheduleTableTaskActivation): OsScheduleTableActivateTaskRef=TASK_TIME_1MS
        EP_29: OsScheduleTblExpPointOffset=29
          4 x OsScheduleTableTaskActivation:
            Ac0: OsScheduleTableActivateTaskRef=TASK_TIME_1MS
            Ac1: OsScheduleTableActivateTaskRef=TASK_TIME_2MS
            Ac2: OsScheduleTableActivateTaskRef=TASK_TIME_5MS
            Ac3: OsScheduleTableActivateTaskRef=TASK_TIME_10MS
        EP_30: OsScheduleTblExpPointOffset=30
          Ac0 (OsScheduleTableTaskActivation): OsScheduleTableActivateTaskRef=TASK_TIME_1MS
        EP_31: OsScheduleTblExpPointOffset=31
          Ac0 (OsScheduleTableTaskActivation): OsScheduleTableActivateTaskRef=TASK_TIME_1MS
          Ac1 (OsScheduleTableTaskActivation): OsScheduleTableActivateTaskRef=TASK_TIME_2MS
        EP_32: OsScheduleTblExpPointOffset=32
          Ac0 (OsScheduleTableTaskActivation): OsScheduleTableActivateTaskRef=TASK_TIME_1MS
        EP_33: OsScheduleTblExpPointOffset=33
          Ac0 (OsScheduleTableTaskActivation): OsScheduleTableActivateTaskRef=TASK_TIME_1MS
          Ac1 (OsScheduleTableTaskActivation): OsScheduleTableActivateTaskRef=TASK_TIME_2MS
        EP_34: OsScheduleTblExpPointOffset=34
          Ac0 (OsScheduleTableTaskActivation): OsScheduleTableActivateTaskRef=TASK_TIME_1MS
          Ac1 (OsScheduleTableTaskActivation): OsScheduleTableActivateTaskRef=TASK_TIME_5MS
        EP_35: OsScheduleTblExpPointOffset=35
          Ac0 (OsScheduleTableTaskActivation): OsScheduleTableActivateTaskRef=TASK_TIME_1MS
          Ac1 (OsScheduleTableTaskActivation): OsScheduleTableActivateTaskRef=TASK_TIME_2MS
        EP_36: OsScheduleTblExpPointOffset=36
          Ac0 (OsScheduleTableTaskActivation): OsScheduleTableActivateTaskRef=TASK_TIME_1MS
        EP_37: OsScheduleTblExpPointOffset=37
          Ac0 (OsScheduleTableTaskActivation): OsScheduleTableActivateTaskRef=TASK_TIME_1MS
          Ac1 (OsScheduleTableTaskActivation): OsScheduleTableActivateTaskRef=TASK_TIME_2MS
        EP_38: OsScheduleTblExpPointOffset=38
          Ac0 (OsScheduleTableTaskActivation): OsScheduleTableActivateTaskRef=TASK_TIME_1MS
        EP_39: OsScheduleTblExpPointOffset=39
          5 x OsScheduleTableTaskActivation:
            Ac0: OsScheduleTableActivateTaskRef=TASK_TIME_1MS
            Ac1: OsScheduleTableActivateTaskRef=TASK_TIME_2MS
            Ac2: OsScheduleTableActivateTaskRef=TASK_TIME_5MS
            Ac3: OsScheduleTableActivateTaskRef=TASK_TIME_10MS
            Ac4: OsScheduleTableActivateTaskRef=TASK_TIME_20MS
        EP_40: OsScheduleTblExpPointOffset=40
          Ac0 (OsScheduleTableTaskActivation): OsScheduleTableActivateTaskRef=TASK_TIME_1MS
        EP_41: OsScheduleTblExpPointOffset=41
          Ac0 (OsScheduleTableTaskActivation): OsScheduleTableActivateTaskRef=TASK_TIME_1MS
          Ac1 (OsScheduleTableTaskActivation): OsScheduleTableActivateTaskRef=TASK_TIME_2MS
        EP_42: OsScheduleTblExpPointOffset=42
          Ac0 (OsScheduleTableTaskActivation): OsScheduleTableActivateTaskRef=TASK_TIME_1MS
        EP_43: OsScheduleTblExpPointOffset=43
          Ac0 (OsScheduleTableTaskActivation): OsScheduleTableActivateTaskRef=TASK_TIME_1MS
          Ac1 (OsScheduleTableTaskActivation): OsScheduleTableActivateTaskRef=TASK_TIME_2MS
        EP_44: OsScheduleTblExpPointOffset=44
          Ac0 (OsScheduleTableTaskActivation): OsScheduleTableActivateTaskRef=TASK_TIME_1MS
          Ac1 (OsScheduleTableTaskActivation): OsScheduleTableActivateTaskRef=TASK_TIME_5MS
        EP_45: OsScheduleTblExpPointOffset=45
          Ac0 (OsScheduleTableTaskActivation): OsScheduleTableActivateTaskRef=TASK_TIME_1MS
          Ac1 (OsScheduleTableTaskActivation): OsScheduleTableActivateTaskRef=TASK_TIME_2MS
        EP_46: OsScheduleTblExpPointOffset=46
          Ac0 (OsScheduleTableTaskActivation): OsScheduleTableActivateTaskRef=TASK_TIME_1MS
        EP_47: OsScheduleTblExpPointOffset=47
          Ac0 (OsScheduleTableTaskActivation): OsScheduleTableActivateTaskRef=TASK_TIME_1MS
          Ac1 (OsScheduleTableTaskActivation): OsScheduleTableActivateTaskRef=TASK_TIME_2MS
        EP_48: OsScheduleTblExpPointOffset=48
          Ac0 (OsScheduleTableTaskActivation): OsScheduleTableActivateTaskRef=TASK_TIME_1MS
        EP_49: OsScheduleTblExpPointOffset=49
          5 x OsScheduleTableTaskActivation:
            Ac0: OsScheduleTableActivateTaskRef=TASK_TIME_1MS
            Ac1: OsScheduleTableActivateTaskRef=TASK_TIME_2MS
            Ac2: OsScheduleTableActivateTaskRef=TASK_TIME_5MS
            Ac3: OsScheduleTableActivateTaskRef=TASK_TIME_10MS
            Ac4: OsScheduleTableActivateTaskRef=TASK_TIME_50MS
        EP_50: OsScheduleTblExpPointOffset=50
          Ac0 (OsScheduleTableTaskActivation): OsScheduleTableActivateTaskRef=TASK_TIME_1MS
        EP_51: OsScheduleTblExpPointOffset=51
          Ac0 (OsScheduleTableTaskActivation): OsScheduleTableActivateTaskRef=TASK_TIME_1MS
          Ac1 (OsScheduleTableTaskActivation): OsScheduleTableActivateTaskRef=TASK_TIME_2MS
        EP_52: OsScheduleTblExpPointOffset=52
          Ac0 (OsScheduleTableTaskActivation): OsScheduleTableActivateTaskRef=TASK_TIME_1MS
        EP_53: OsScheduleTblExpPointOffset=53
          Ac0 (OsScheduleTableTaskActivation): OsScheduleTableActivateTaskRef=TASK_TIME_1MS
          Ac1 (OsScheduleTableTaskActivation): OsScheduleTableActivateTaskRef=TASK_TIME_2MS
        EP_54: OsScheduleTblExpPointOffset=54
          Ac0 (OsScheduleTableTaskActivation): OsScheduleTableActivateTaskRef=TASK_TIME_1MS
          Ac1 (OsScheduleTableTaskActivation): OsScheduleTableActivateTaskRef=TASK_TIME_5MS
        EP_55: OsScheduleTblExpPointOffset=55
          Ac0 (OsScheduleTableTaskActivation): OsScheduleTableActivateTaskRef=TASK_TIME_1MS
          Ac1 (OsScheduleTableTaskActivation): OsScheduleTableActivateTaskRef=TASK_TIME_2MS
        EP_56: OsScheduleTblExpPointOffset=56
          Ac0 (OsScheduleTableTaskActivation): OsScheduleTableActivateTaskRef=TASK_TIME_1MS
        EP_57: OsScheduleTblExpPointOffset=57
          Ac0 (OsScheduleTableTaskActivation): OsScheduleTableActivateTaskRef=TASK_TIME_1MS
          Ac1 (OsScheduleTableTaskActivation): OsScheduleTableActivateTaskRef=TASK_TIME_2MS
        EP_58: OsScheduleTblExpPointOffset=58
          Ac0 (OsScheduleTableTaskActivation): OsScheduleTableActivateTaskRef=TASK_TIME_1MS
        EP_59: OsScheduleTblExpPointOffset=59
          5 x OsScheduleTableTaskActivation:
            Ac0: OsScheduleTableActivateTaskRef=TASK_TIME_1MS
            Ac1: OsScheduleTableActivateTaskRef=TASK_TIME_2MS
            Ac2: OsScheduleTableActivateTaskRef=TASK_TIME_5MS
            Ac3: OsScheduleTableActivateTaskRef=TASK_TIME_10MS
            Ac4: OsScheduleTableActivateTaskRef=TASK_TIME_20MS
        EP_60: OsScheduleTblExpPointOffset=60
          Ac0 (OsScheduleTableTaskActivation): OsScheduleTableActivateTaskRef=TASK_TIME_1MS
        EP_61: OsScheduleTblExpPointOffset=61
          Ac0 (OsScheduleTableTaskActivation): OsScheduleTableActivateTaskRef=TASK_TIME_1MS
          Ac1 (OsScheduleTableTaskActivation): OsScheduleTableActivateTaskRef=TASK_TIME_2MS
        EP_62: OsScheduleTblExpPointOffset=62
          Ac0 (OsScheduleTableTaskActivation): OsScheduleTableActivateTaskRef=TASK_TIME_1MS
        EP_63: OsScheduleTblExpPointOffset=63
          Ac0 (OsScheduleTableTaskActivation): OsScheduleTableActivateTaskRef=TASK_TIME_1MS
          Ac1 (OsScheduleTableTaskActivation): OsScheduleTableActivateTaskRef=TASK_TIME_2MS
        EP_64: OsScheduleTblExpPointOffset=64
          Ac0 (OsScheduleTableTaskActivation): OsScheduleTableActivateTaskRef=TASK_TIME_1MS
          Ac1 (OsScheduleTableTaskActivation): OsScheduleTableActivateTaskRef=TASK_TIME_5MS
        EP_65: OsScheduleTblExpPointOffset=65
          Ac0 (OsScheduleTableTaskActivation): OsScheduleTableActivateTaskRef=TASK_TIME_1MS
          Ac1 (OsScheduleTableTaskActivation): OsScheduleTableActivateTaskRef=TASK_TIME_2MS
        EP_66: OsScheduleTblExpPointOffset=66
          Ac0 (OsScheduleTableTaskActivation): OsScheduleTableActivateTaskRef=TASK_TIME_1MS
        EP_67: OsScheduleTblExpPointOffset=67
          Ac0 (OsScheduleTableTaskActivation): OsScheduleTableActivateTaskRef=TASK_TIME_1MS
          Ac1 (OsScheduleTableTaskActivation): OsScheduleTableActivateTaskRef=TASK_TIME_2MS
        EP_68: OsScheduleTblExpPointOffset=68
          Ac0 (OsScheduleTableTaskActivation): OsScheduleTableActivateTaskRef=TASK_TIME_1MS
        EP_69: OsScheduleTblExpPointOffset=69
          4 x OsScheduleTableTaskActivation:
            Ac0: OsScheduleTableActivateTaskRef=TASK_TIME_1MS
            Ac1: OsScheduleTableActivateTaskRef=TASK_TIME_2MS
            Ac2: OsScheduleTableActivateTaskRef=TASK_TIME_5MS
            Ac3: OsScheduleTableActivateTaskRef=TASK_TIME_10MS
        EP_70: OsScheduleTblExpPointOffset=70
          Ac0 (OsScheduleTableTaskActivation): OsScheduleTableActivateTaskRef=TASK_TIME_1MS
        EP_71: OsScheduleTblExpPointOffset=71
          Ac0 (OsScheduleTableTaskActivation): OsScheduleTableActivateTaskRef=TASK_TIME_1MS
          Ac1 (OsScheduleTableTaskActivation): OsScheduleTableActivateTaskRef=TASK_TIME_2MS
        EP_72: OsScheduleTblExpPointOffset=72
          Ac0 (OsScheduleTableTaskActivation): OsScheduleTableActivateTaskRef=TASK_TIME_1MS
        EP_73: OsScheduleTblExpPointOffset=73
          Ac0 (OsScheduleTableTaskActivation): OsScheduleTableActivateTaskRef=TASK_TIME_1MS
          Ac1 (OsScheduleTableTaskActivation): OsScheduleTableActivateTaskRef=TASK_TIME_2MS
        EP_74: OsScheduleTblExpPointOffset=74
          Ac0 (OsScheduleTableTaskActivation): OsScheduleTableActivateTaskRef=TASK_TIME_1MS
          Ac1 (OsScheduleTableTaskActivation): OsScheduleTableActivateTaskRef=TASK_TIME_5MS
        EP_75: OsScheduleTblExpPointOffset=75
          Ac0 (OsScheduleTableTaskActivation): OsScheduleTableActivateTaskRef=TASK_TIME_1MS
          Ac1 (OsScheduleTableTaskActivation): OsScheduleTableActivateTaskRef=TASK_TIME_2MS
        EP_76: OsScheduleTblExpPointOffset=76
          Ac0 (OsScheduleTableTaskActivation): OsScheduleTableActivateTaskRef=TASK_TIME_1MS
        EP_77: OsScheduleTblExpPointOffset=77
          Ac0 (OsScheduleTableTaskActivation): OsScheduleTableActivateTaskRef=TASK_TIME_1MS
          Ac1 (OsScheduleTableTaskActivation): OsScheduleTableActivateTaskRef=TASK_TIME_2MS
        EP_78: OsScheduleTblExpPointOffset=78
          Ac0 (OsScheduleTableTaskActivation): OsScheduleTableActivateTaskRef=TASK_TIME_1MS
        EP_79: OsScheduleTblExpPointOffset=79
          5 x OsScheduleTableTaskActivation:
            Ac0: OsScheduleTableActivateTaskRef=TASK_TIME_1MS
            Ac1: OsScheduleTableActivateTaskRef=TASK_TIME_2MS
            Ac2: OsScheduleTableActivateTaskRef=TASK_TIME_5MS
            Ac3: OsScheduleTableActivateTaskRef=TASK_TIME_10MS
            Ac4: OsScheduleTableActivateTaskRef=TASK_TIME_20MS
        EP_80: OsScheduleTblExpPointOffset=80
          Ac0 (OsScheduleTableTaskActivation): OsScheduleTableActivateTaskRef=TASK_TIME_1MS
        EP_81: OsScheduleTblExpPointOffset=81
          Ac0 (OsScheduleTableTaskActivation): OsScheduleTableActivateTaskRef=TASK_TIME_1MS
          Ac1 (OsScheduleTableTaskActivation): OsScheduleTableActivateTaskRef=TASK_TIME_2MS
        EP_82: OsScheduleTblExpPointOffset=82
          Ac0 (OsScheduleTableTaskActivation): OsScheduleTableActivateTaskRef=TASK_TIME_1MS
        EP_83: OsScheduleTblExpPointOffset=83
          Ac0 (OsScheduleTableTaskActivation): OsScheduleTableActivateTaskRef=TASK_TIME_1MS
          Ac1 (OsScheduleTableTaskActivation): OsScheduleTableActivateTaskRef=TASK_TIME_2MS
        EP_84: OsScheduleTblExpPointOffset=84
          Ac0 (OsScheduleTableTaskActivation): OsScheduleTableActivateTaskRef=TASK_TIME_1MS
          Ac1 (OsScheduleTableTaskActivation): OsScheduleTableActivateTaskRef=TASK_TIME_5MS
        EP_85: OsScheduleTblExpPointOffset=85
          Ac0 (OsScheduleTableTaskActivation): OsScheduleTableActivateTaskRef=TASK_TIME_1MS
          Ac1 (OsScheduleTableTaskActivation): OsScheduleTableActivateTaskRef=TASK_TIME_2MS
        EP_86: OsScheduleTblExpPointOffset=86
          Ac0 (OsScheduleTableTaskActivation): OsScheduleTableActivateTaskRef=TASK_TIME_1MS
        EP_87: OsScheduleTblExpPointOffset=87
          Ac0 (OsScheduleTableTaskActivation): OsScheduleTableActivateTaskRef=TASK_TIME_1MS
          Ac1 (OsScheduleTableTaskActivation): OsScheduleTableActivateTaskRef=TASK_TIME_2MS
        EP_88: OsScheduleTblExpPointOffset=88
          Ac0 (OsScheduleTableTaskActivation): OsScheduleTableActivateTaskRef=TASK_TIME_1MS
        EP_89: OsScheduleTblExpPointOffset=89
          4 x OsScheduleTableTaskActivation:
            Ac0: OsScheduleTableActivateTaskRef=TASK_TIME_1MS
            Ac1: OsScheduleTableActivateTaskRef=TASK_TIME_2MS
            Ac2: OsScheduleTableActivateTaskRef=TASK_TIME_5MS
            Ac3: OsScheduleTableActivateTaskRef=TASK_TIME_10MS
        EP_90: OsScheduleTblExpPointOffset=90
          Ac0 (OsScheduleTableTaskActivation): OsScheduleTableActivateTaskRef=TASK_TIME_1MS
        EP_91: OsScheduleTblExpPointOffset=91
          Ac0 (OsScheduleTableTaskActivation): OsScheduleTableActivateTaskRef=TASK_TIME_1MS
          Ac1 (OsScheduleTableTaskActivation): OsScheduleTableActivateTaskRef=TASK_TIME_2MS
        EP_92: OsScheduleTblExpPointOffset=92
          Ac0 (OsScheduleTableTaskActivation): OsScheduleTableActivateTaskRef=TASK_TIME_1MS
        EP_93: OsScheduleTblExpPointOffset=93
          Ac0 (OsScheduleTableTaskActivation): OsScheduleTableActivateTaskRef=TASK_TIME_1MS
          Ac1 (OsScheduleTableTaskActivation): OsScheduleTableActivateTaskRef=TASK_TIME_2MS
        EP_94: OsScheduleTblExpPointOffset=94
          Ac0 (OsScheduleTableTaskActivation): OsScheduleTableActivateTaskRef=TASK_TIME_1MS
          Ac1 (OsScheduleTableTaskActivation): OsScheduleTableActivateTaskRef=TASK_TIME_5MS
        EP_95: OsScheduleTblExpPointOffset=95
          Ac0 (OsScheduleTableTaskActivation): OsScheduleTableActivateTaskRef=TASK_TIME_1MS
          Ac1 (OsScheduleTableTaskActivation): OsScheduleTableActivateTaskRef=TASK_TIME_2MS
        EP_96: OsScheduleTblExpPointOffset=96
          Ac0 (OsScheduleTableTaskActivation): OsScheduleTableActivateTaskRef=TASK_TIME_1MS
        EP_97: OsScheduleTblExpPointOffset=97
          Ac0 (OsScheduleTableTaskActivation): OsScheduleTableActivateTaskRef=TASK_TIME_1MS
          Ac1 (OsScheduleTableTaskActivation): OsScheduleTableActivateTaskRef=TASK_TIME_2MS
        EP_98: OsScheduleTblExpPointOffset=98
          Ac0 (OsScheduleTableTaskActivation): OsScheduleTableActivateTaskRef=TASK_TIME_1MS
        EP_99: OsScheduleTblExpPointOffset=99
          6 x OsScheduleTableTaskActivation:
            Ac0: OsScheduleTableActivateTaskRef=TASK_TIME_1MS
            Ac1: OsScheduleTableActivateTaskRef=TASK_TIME_2MS
            Ac2: OsScheduleTableActivateTaskRef=TASK_TIME_5MS
            Ac3: OsScheduleTableActivateTaskRef=TASK_TIME_10MS
            Ac4: OsScheduleTableActivateTaskRef=TASK_TIME_20MS
            Ac5: OsScheduleTableActivateTaskRef=TASK_TIME_50MS
      OsScheduleTableAutostart: OsScheduleTableAutostartType=RELATIVE, OsScheduleTableStartValue=1, OsScheduleTableAppModeRef=OSDEFAULTAPPMODE
      OsScheduleTableSync: OsScheduleTblSyncStrategy=NONE
    MAIN_OSSCT_PIM50ms (OsScheduleTable): OsScheduleTableRepeating=true, OsScheduleTableDuration=20, OsScheduleTableCounterRef=MAIN_OSCNT_PIM50ms
      10 x OsScheduleTableExpiryPoint:
        EP_1: OsScheduleTblExpPointOffset=1
          Ac0 (OsScheduleTableTaskActivation): OsScheduleTableActivateTaskRef=TASK_TIME_100MS
        EP_3: OsScheduleTblExpPointOffset=3
          Ac0 (OsScheduleTableTaskActivation): OsScheduleTableActivateTaskRef=TASK_TIME_100MS
          Ac1 (OsScheduleTableTaskActivation): OsScheduleTableActivateTaskRef=TASK_TIME_200MS
        EP_5: OsScheduleTblExpPointOffset=5
          Ac0 (OsScheduleTableTaskActivation): OsScheduleTableActivateTaskRef=TASK_TIME_100MS
        EP_7: OsScheduleTblExpPointOffset=7
          Ac0 (OsScheduleTableTaskActivation): OsScheduleTableActivateTaskRef=TASK_TIME_100MS
          Ac1 (OsScheduleTableTaskActivation): OsScheduleTableActivateTaskRef=TASK_TIME_200MS
        EP_9: OsScheduleTblExpPointOffset=9
          Ac0 (OsScheduleTableTaskActivation): OsScheduleTableActivateTaskRef=TASK_TIME_100MS
        EP_11: OsScheduleTblExpPointOffset=11
          Ac0 (OsScheduleTableTaskActivation): OsScheduleTableActivateTaskRef=TASK_TIME_100MS
          Ac1 (OsScheduleTableTaskActivation): OsScheduleTableActivateTaskRef=TASK_TIME_200MS
        EP_13: OsScheduleTblExpPointOffset=13
          Ac0 (OsScheduleTableTaskActivation): OsScheduleTableActivateTaskRef=TASK_TIME_100MS
        EP_15: OsScheduleTblExpPointOffset=15
          Ac0 (OsScheduleTableTaskActivation): OsScheduleTableActivateTaskRef=TASK_TIME_100MS
          Ac1 (OsScheduleTableTaskActivation): OsScheduleTableActivateTaskRef=TASK_TIME_200MS
        EP_17: OsScheduleTblExpPointOffset=17
          Ac0 (OsScheduleTableTaskActivation): OsScheduleTableActivateTaskRef=TASK_TIME_100MS
        EP_19: OsScheduleTblExpPointOffset=19
          3 x OsScheduleTableTaskActivation:
            Ac0: OsScheduleTableActivateTaskRef=TASK_TIME_100MS
            Ac1: OsScheduleTableActivateTaskRef=TASK_TIME_200MS
            Ac2: OsScheduleTableActivateTaskRef=TASK_TIME_1000MS
      OsScheduleTableAutostart: OsScheduleTableAutostartType=RELATIVE, OsScheduleTableStartValue=1, OsScheduleTableAppModeRef=OSDEFAULTAPPMODE
      OsScheduleTableSync: OsScheduleTblSyncStrategy=NONE
    5 x OsIsr, all with OsIsrCategory=CATEGORY_2:
      DMA_ISR_QSPI2RX: OsIsrPriority=33, OsIsrAddress=SRC_DMACH4
      DMA_ISR_QSPI2TX: OsIsrPriority=34, OsIsrAddress=SRC_DMACH5
      SRC_QSPI_QSPI2_ERR_ISR: OsIsrPriority=104, OsIsrAddress=SRC_QSPI2ERR
      SRC_QSPI_QSPI2_PT_ISR: OsIsrPriority=105, OsIsrAddress=SRC_QSPI2PT
      SRC_QSPI_QSPI2_U_ISR: OsIsrPriority=106, OsIsrAddress=SRC_QSPI2U
